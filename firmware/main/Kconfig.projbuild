## firmware/main/Kconfig.projbuild
```kconfig
menu "CARBENTRA physical qualification"
config CARBENTRA_SWITCH_ALLOW_ACTUATION
    bool "Permit qualified and individually commissioned relay energizing"
    default n
    help
        Keep disabled for prototype and software validation builds. Enabling this
        is not qualification. Each unit also needs deliberate factory commissioning.
endmenu
```

## firmware/sdkconfig.defaults
```kconfig
CONFIG_IDF_TARGET="esp32c3"
CONFIG_ESPTOOLPY_FLASHSIZE_4MB=y
CONFIG_PARTITION_TABLE_CUSTOM=y
CONFIG_PARTITION_TABLE_CUSTOM_FILENAME="partitions.csv"
CONFIG_BT_ENABLED=y
CONFIG_BT_NIMBLE_ENABLED=y
CONFIG_BT_NIMBLE_MAX_CONNECTIONS=1
CONFIG_ESP_PROTOCOMM_SUPPORT_SECURITY_VERSION_0=n
CONFIG_ESP_PROTOCOMM_SUPPORT_SECURITY_VERSION_1=n
CONFIG_ESP_PROTOCOMM_SUPPORT_SECURITY_VERSION_2=y
CONFIG_MBEDTLS_CERTIFICATE_BUNDLE=n
CONFIG_MBEDTLS_SSL_PROTO_TLS1_2=y
CONFIG_ESP_TLS_INSECURE=n
CONFIG_ESP_WIFI_SOFTAP_SUPPORT=n
CONFIG_LOG_DEFAULT_LEVEL_INFO=y
CONFIG_COMPILER_OPTIMIZATION_SIZE=y

# Physical relay release remains separate from software validation.
# CONFIG_CARBENTRA_SWITCH_ALLOW_ACTUATION is not set
```
